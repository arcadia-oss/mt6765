## drivers/input/fingerprint/Kconfig
```kconfig
#
#Fingerprint
#
menu "Fingerprint support"
	depends on INPUT

config FPC_FINGERPRINT
	bool "FPC Fingerprint"
	default n
	help
	  FPC fingerprint FPC's 102x/104x device.
	  
config MTK_FINGERPRINT_SUPPORT
	bool "Mediatek Fingerprint"
	default n
	help
	  Fingerprint mtk driver enable/disable
	  in the kernel.Say Y here if you want to
	  use mediatek fingerprint driver,fingerprint
	  driver will support fingerprint function

config MTK_FINGERPRINT_SELECT
	string "sensor type"
	default "GF318M"


endmenu
```

## drivers/misc/mediatek/sensors-1.0/accelerometer/lsm6ds3-acc-new/Kconfig
```kconfig
config MTK_LSM6DS3_ACC_NEW
	bool "LSM6DS3_ACC for MediaTek package"
	default n
	help
	  It support different accelerometer sensor.
          If this option is set,
	  it will support
          LSM6DS3_ACC Accelerometer.
```

## drivers/misc/mediatek/sensors-1.0/magnetometer/af6133/Kconfig
```kconfig
config MTK_A6133
	bool "A6133 for MediaTek package"
	default n
	help
	  It support different magnetometer sensor.
          If this option is set,
	  it will support
          A6133 magnetometer.
```
